## ex9/task/kws-on-gap9/application/Kconfig
```kconfig
menu "ODDA APP menu"
	
	comment "Options"

	config MANDATORY
            bool
            default y
            select DRIVER_SFU
            select DRIVER_SFU_RUNTIME_V2
            select DRIVER_SFU_OPTION_AUDIO_SW_QUEUES
            select DRIVER_I2S

endmenu

source "$(GAP_SDK_HOME)/utils/kconfig/Kconfig"
```
